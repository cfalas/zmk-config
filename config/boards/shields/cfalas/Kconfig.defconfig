## config/boards/shields/cfalas/Kconfig.defconfig
```kconfig
if SHIELD_CFALAS_LEFT

config ZMK_KEYBOARD_NAME
    default "@cfalas kbd"

config ZMK_SPLIT_ROLE_CENTRAL
    default y

endif

if SHIELD_CFALAS_RIGHT
config ZMK_KEYBOARD_NAME
    default "@cfalas right"
endif

if SHIELD_CFALAS_LEFT || SHIELD_CFALAS_RIGHT

config ZMK_SPLIT
    default y

endif
```

## config/boards/shields/cfalas/Kconfig.shield
```kconfig
config SHIELD_CFALAS_LEFT
    def_bool $(shields_list_contains,cfalas_left)
config SHIELD_CFALAS_RIGHT
    def_bool $(shields_list_contains,cfalas_right)
```
